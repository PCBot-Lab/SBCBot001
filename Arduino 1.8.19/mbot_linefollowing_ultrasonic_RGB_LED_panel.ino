// generated by mBlock5 for mBot
// codes make you happy

#include <MeMCore.h>
#include <Arduino.h>
#include <Wire.h>
#include <SoftwareSerial.h>

MeUltrasonicSensor ultrasonic_3(3);
MeLEDMatrix ledMtx_2(2);
unsigned char drawBuffer[16];
unsigned char *drawTemp;
MeRGBLed rgbled_7(7, 2);
MeLineFollower linefollower_1(1);
MeDCMotor motor_9(9);
MeDCMotor motor_10(10);
MeBuzzer buzzer;

float color1 = 0;
float color2 = 0;
float color3 = 0;
float both_over_line = 0;
float left_over_right_out_line = 0;
float right_over_left_out_line = 0;
float both_out_line = 0;

void move(int direction, int speed) {
  int leftSpeed = 0;
  int rightSpeed = 0;
  if(direction == 1) {
    leftSpeed = speed;
    rightSpeed = speed;
  } else if(direction == 2) {
    leftSpeed = -speed;
    rightSpeed = -speed;
  } else if(direction == 3) {
    leftSpeed = -speed;
    rightSpeed = speed;
  } else if(direction == 4) {
    leftSpeed = speed;
    rightSpeed = -speed;
  }
  motor_9.run((9) == M1 ? -(leftSpeed) : (leftSpeed));
  motor_10.run((10) == M1 ? -(rightSpeed) : (rightSpeed));
}

void _delay(float seconds) {
  long endTime = millis() + seconds * 1000;
  while(millis() < endTime) _loop();
}

void setup() {
  ledMtx_2.setColorIndex(1);
  ledMtx_2.setBrightness(6);
  rgbled_7.fillPixelsBak(0, 2, 1);
  both_over_line = 0;
  left_over_right_out_line = 1;
  right_over_left_out_line = 2;
  both_out_line = 3;
  color1 = 150;
  color2 = 150;
  color3 = 150;
  while(1) {
      if(ultrasonic_3.distanceCm() > 10){

          drawTemp = new unsigned char[16]{0,0,60,126,126,60,0,0,0,0,60,126,126,60,0,0};
          memcpy(drawBuffer, drawTemp, 16);
          free(drawTemp);
          ledMtx_2.drawBitmap(0, 0, 16, drawBuffer);
          _delay(0.2);
          ledMtx_2.clearScreen();
          color1 += random(-100, 100 +1);
          color2 += random(-100, 100 +1);
          color3 += random(-100, 100 +1);

          rgbled_7.setColor(0, color1, color2, color3);
          rgbled_7.show();
          if(linefollower_1.readSensors() == both_over_line){

              move(1, 50 / 100.0 * 255);

          }
          if(linefollower_1.readSensors() == left_over_right_out_line){

              move(3, 50 / 100.0 * 255);

          }
          if(linefollower_1.readSensors() == right_over_left_out_line){

              move(4, 50 / 100.0 * 255);

          }
          if(linefollower_1.readSensors() == both_out_line){

              move(2, 50 / 100.0 * 255);
              _delay(0.2);

          }

      }else{
          motor_9.run(0);
          motor_10.run(0);
          ledMtx_2.clearScreen();

          rgbled_7.setColor(0, 0, 0, 0);
          rgbled_7.show();

          buzzer.tone(262, 0.25 * 1000);
          _delay(0.02);

      }

      _loop();
  }

}

void _loop() {
}

void loop() {
  _loop();
}
